#include <reg52.h>           
unsigned char t0,t1; 
sbit WE1 = P2^0;
//函数功能：实现0.5延时
void delay0_5s1()
{  
   for(t0=0;t0<10;t0++)		//采用全局变量t0作为循环控制变量
   {     	
   TH1=(65536-50000)/256;	//设置定时器初值
   TL1=(65536-50000)%256;  
	 TR1=1;	               		//启动T1
   while(!TF1);       //查询计数是否溢出，即50ms定时时间到，TF1=1
   TF1=0;	      //50ms定时时间到，将定时器溢出标志位TF1清零
   }
}
//函数名：delay_t1
//函数功能：实现0.5～128s延时
void delay_t1(unsigned char t)
{
    for(t1=0;t1<t;t1++)    	//采用全局变量t1作为循环控制变量
    delay0_5s1();
}
//函数名：int_0
//函数功能：外部中断0中断函数，紧急情况处理，当CPU响应外部中断0的中断请求时，
//          自动执行该函数，实现两个方向红灯同时亮10 s
//形式参数：无
//返回值：无
void int_0()  interrupt 0     	//紧急情况中断
{
	unsigned char i,j,k,l,m;
	i=P1;				//保护现场，暂存P1口、t0、t1、TH1、TL1
	j=t0;
	k=t1;
	l=TH1;
	m=TL1;
	P1=0x7b;			//两个方向都是红灯
	P0 = 0x86;    //数码管显示E
	delay_t1(4);	//延时2秒
	P0 = 0xff;
	P0 = 0x82;
	P1=i;			//恢复现场，恢复进入中断前P1口、t0、t1、TH1、TL1
	t0=j;
	t1=k;
	TH1=l;
	TL1=m;
}
void main()			//主函数			
{
	TMOD=0x10;			//T1设置为工作方式1
	EA=1;   				//开总中断允许位
	EX0=1;  				//开外部中断0中断允许位
	IT0=1;   				//设置外部中断0为下降沿触发
	WE1 = 0;				//第一个数码管开启
	while(1)
	{
		P0 =0x82;			//数码管6
		//南北绿灯亮两秒，东西红灯亮两秒
		P1=0x7e;			
		delay_t1(4);				  
   	//南北黄灯亮0.5秒，间隔0.5秒，东西红灯亮1秒
    P1=0x7d;
    delay0_5s1();			
    P1=0x7f;
    delay0_5s1();		
		//南北红灯亮两秒，东西绿灯亮两秒
		P1=0xdb;					
		delay_t1(4);
		//南北红灯亮1秒，东西黄灯亮0.5秒，间隔0.5秒
    P1=0xbb;
    delay0_5s1();	
    P1=0xfb;
    delay0_5s1();	
	 }
 }
